# nvic register map
Vendor: Texas Instruments
Peripheral module from a debugger description file (folder cc32).
Registers are 32-bit, access not given, no defined reset value unless marked. A register's access mark holds for its fields unless they carry their own. Offsets are as the file gives them; lines under a group give offsets from that group; [hi:lo] are bit positions; {n}, {i} and the like mark numbered series; 'fields as' and 'values as' point back to an identical list; <NAME> marks a mode.

## nvic
0x04 INT_TYPE — Interrupt Controller Type Reg
0x08 ACTLR — Auxiliary Control
0x10 ST_CTRL — SysTick Control and Status Register
0x14 ST_RELOAD — SysTick Reload Value Register
0x18 ST_CURRENT — SysTick Current Value Register
0x1C ST_CAL — SysTick Calibration Value Reg
0x100 EN0 — Interrupt 0-31 Set Enable
0x104 EN1 — Interrupt 32-54 Set Enable
0x108 EN2 — Interrupt 64-95 Set Enable
0x10C EN3 — Interrupt 96-127 Set Enable
0x110 EN4 — Interrupt 128-131 Set Enable
0x114 EN5 — Interrupt 160-191 Set Enable
0x180 DIS0 — Interrupt 0-31 Clear Enable
0x184 DIS1 — Interrupt 32-54 Clear Enable
0x188 DIS2 — Interrupt 64-95 Clear Enable
0x18C DIS3 — Interrupt 96-127 Clear Enable
0x190 DIS4 — Interrupt 128-131 Clear Enable
0x194 DIS5 — Interrupt 160-191 Clear Enable
0x200 PEND0 — Interrupt 0-31 Set Pending
0x204 PEND1 — Interrupt 32-54 Set Pending
0x208 PEND2 — Interrupt 64-95 Set Pending
0x20C PEND3 — Interrupt 96-127 Set Pending
0x210 PEND4 — Interrupt 128-131 Set Pending
0x214 PEND5 — Interrupt 160-191 Set Pending
0x280 UNPEND0 — Interrupt 0-31 Clear Pending
0x284 UNPEND1 — Interrupt 32-54 Clear Pending
0x288 UNPEND2 — Interrupt 64-95 Clear Pending
0x28C UNPEND3 — Interrupt 96-127 Clear Pending
0x290 UNPEND4 — Interrupt 128-131 Clear Pending
0x294 UNPEND5 — Interrupt 160-191 Clear Pending
0x300 ACTIVE0 — Interrupt 0-31 Active Bit
0x304 ACTIVE1 — Interrupt 32-54 Active Bit
0x308 ACTIVE2 — Interrupt 64-95 Active Bit
0x30C ACTIVE3 — Interrupt 96-127 Active Bit
0x310 ACTIVE4 — Interrupt 128-131 Active Bit
0x314 ACTIVE5 — Interrupt 160-191 Active Bit
{0x400+4i} PRI{i} (i=0..12) — Interrupt {4i}-{4i+3} Priority
0x434 PRI13 — Interrupt 52-53 Priority
{0x400+4i} PRI{i} (i=14..48) — Interrupt {4i}-{4i+3} Priority
0xD00 CPUID — CPU ID Base
0xD04 INT_CTRL — Interrupt Control and State
0xD08 VTABLE — Vector Table Offset
0xD0C APINT — Application Interrupt and Reset Control
0xD10 SYS_CTRL — System Control
0xD14 CFG_CTRL — Configuration and Control
{0xD14+4i} SYS_PRI{i} (i=1..3) — System Handler Priority {i}
0xD24 SYS_HND_CTRL — System Handler Control and State
0xD28 FAULT_STAT — Configurable Fault Status
0xD2C HFAULT_STAT — Hard Fault Status
0xD30 DEBUG_STAT — Debug Status Register
0xD34 MM_ADDR — Memory Management Fault Address
0xD38 FAULT_ADDR — Bus Fault Address
0xD90 MPU_TYPE
0xD94 MPU_CTRL — MPU Control
0xD98 MPU_NUMBER — MPU Region Number
0xD9C MPU_BASE — MPU Region Base Address
0xDA0 MPU_ATTR — MPU Region Attribute and Size
{0xD9C+8i} MPU_BASE{i} (i=1..3) — MPU Region Base Address Alias {i}
{0xDA0+8i} MPU_ATTR{i} (i=1..3) — MPU Region Attribute and Size Alias {i}
0xDF0 DBG_CTRL — Debug Control and Status Reg
0xDF4 DBG_XFER — Debug Core Reg. Transfer Select
0xDF8 DBG_DATA — Debug Core Register Data
0xDFC DBG_INT — Debug Reset Interrupt Control
0xF00 SW_TRIG — Software Trigger Interrupt ***************************************************************************
