# wdt register map
Vendor: Texas Instruments
Peripheral module from a debugger description file (folder cc32).
Registers are 32-bit, access not given, no defined reset value unless marked. A register's access mark holds for its fields unless they carry their own. Offsets are as the file gives them; lines under a group give offsets from that group; [hi:lo] are bit positions; {n}, {i} and the like mark numbered series; 'fields as' and 'values as' point back to an identical list; <NAME> marks a mode.

## wdt
0x00 LOAD
0x04 VALUE
0x08 CTL
0x0C ICR
0x10 RIS
0x14 MIS
0x418 TEST rw
  [11:10] STALL_EN — Watchdog stall enable
0xC00 LOCK
