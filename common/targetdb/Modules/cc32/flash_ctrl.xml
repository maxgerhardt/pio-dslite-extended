# flash_ctrl register map
Vendor: Texas Instruments
Peripheral module from a debugger description file (folder cc32).
Registers are 32-bit, access not given, no defined reset value unless marked. A register's access mark holds for its fields unless they carry their own. Offsets are as the file gives them; lines under a group give offsets from that group; [hi:lo] are bit positions; {n}, {i} and the like mark numbered series; 'fields as' and 'values as' point back to an identical list; <NAME> marks a mode.

## flash_ctrl
0x00 FMA rw — Flash Memory Address (FMA) offset 0x000 During a write operation this register contains a 4-byte-aligned address and specifies where the data is written. During erase operations this register contains a 1 KB-aligned CPU byte address and specifies which block is erased. Note that the alignment requirements must be met by software or the results of the operation are unpredictable.
  [17:0] OFFSET — Address Offset Address offset in Flash memory where operation is performed except for nonvolatile registers
0x04 FMD — Flash Memory Data (FMD) offset 0x004 This register contains the data to be written during the programming cycle or read during the read cycle. Note that the contents of this register are undefined for a read access of an execute-only block. This register is not used during erase cycles.
0x08 FMC rw — Flash Memory Control (FMC) offset 0x008 When this register is written the Flash memory controller initiates the appropriate access cycle for the location specified by the Flash Memory Address (FMA) register . If the access is a write access the data contained in the Flash Memory Data (FMD) register is written to the specified address. This register must be the final register written and initiates the memory operation. The four control bits in the lower byte of this register are used to initiate memory operations.
  [31:16] WRKEY — Flash Memory Write Key This field contains a write key which is used to minimize the incidence of accidental Flash memory writes. The value 0xA442 must be written into this field for a Flash memory write to occur. Writes to the FMC register without this WRKEY value are ignored. A read of this field returns the value 0.
0x0C FCRIS — Flash Controller Raw Interrupt Status (FCRIS) offset 0x00C This register indicates that the Flash memory controller has an interrupt condition. An interrupt is sent to the interrupt controller only if the corresponding FCIM register bit is set.
0x10 FCIM — Flash Controller Interrupt Mask (FCIM) offset 0x010 This register controls whether the Flash memory controller generates interrupts to the controller.
0x14 FCMISC — Flash Controller Masked Interrupt Status and Clear (FCMISC) offset 0x014 This register provides two functions. First it reports the cause of an interrupt by indicating which interrupt source or sources are signalling the interrupt. Second it serves as the method to clear the interrupt reporting.
0x20 FMC2 rw — Flash Memory Control 2 (FMC2) offset 0x020 When this register is written the Flash memory controller initiates the appropriate access cycle for the location specified by the Flash Memory Address (FMA) register . If the access is a write access the data contained in the Flash Write Buffer (FWB) registers is written. This register must be the final register written as it initiates the memory operation.
  [31:16] WRKEY — Flash Memory Write Key This field contains a write key which is used to minimize the incidence of accidental Flash memory writes. The value 0xA442 must be written into this field for a write to occur. Writes to the FMC2 register without this WRKEY value are ignored. A read of this field returns the value 0.
0x30 FWBVAL — Flash Write Buffer Valid (FWBVAL) offset 0x030 This register provides a bitwise status of which FWBn registers have been written by the processor since the last write of the Flash memory write buffer. The entries with a 1 are written on the next write of the Flash memory write buffer. This register is cleared after the write operation by hardware. A protection violation on the write operation also clears this status. Software can program the same 32 words to various Flash memory locations by setting the FWB[n] bits after they are cleared by the write operation. The next write operation then uses the same data as the previous one. In addition if a FWBn register change should not be written to Flash memory software can clear the corresponding FWB[n] bit to preserve the existing data when the next write operation occurs.
{0xFC+4i} FWB{i} (i=1..32) — Flash Write Buffer n (FWBn) offset 0x100 - 0x17C These 32 registers hold the contents of the data to be written into the Flash memory on a buffered Flash memory write operation. The offset selects one of the 32-bit registers. Only FWBn registers that have been updated since the preceding buffered Flash memory write operation are written into the Flash memory so it is not necessary to write the entire bank of registers in order to write 1 or 2 words. The FWBn registers are written into the Flash memory with the FWB0 register corresponding to the address contained in FMA. FWB1 is written to the address FMA+0x4 etc. Note that only data bits that are 0 result in the Flash memory being modified. A data bit that is 1 leaves the content of the Flash memory bit at its previous value.
0xFC0 FSIZE rw — Flash Size (FSIZE) offset 0xFC0 This register indicates the size of the on-chip Flash memory. Important: This register should be used to determine the size of the Flash memory that is implemented on this microcontroller. However to support legacy software the DC0 register is available. A read of the DC0 register correctly identifies legacy memory sizes. Software must use the FSIZE register for memory sizes that are not listed in the DC0 register description.
  [15:0] SIZE — Flash Size Indicates the size of the on-chip Flash memory. Value Description 0x0003 8 KB of Flash 0x0007 16 KB of Flash 0x000F 32 KB of Flash 0x001F 64 KB of Flash 0x002F 96 KB of Flash 0x003F 128 KB of Flash 0x005F 192 KB of Flash 0x007F 256 KB of Flash
0xFC4 SSIZE rw — SRAM Size (SSIZE) offset 0xFC4 This register indicates the size of the on-chip SRAM. Important: This register should be used to determine the size of the SRAM that is implemented on this microcontroller. However to support legacy software the DC0 register is available. A read of the DC0 register correctly identifies legacy memory sizes. Software must use the SSIZE register for memory sizes that are not listed in the DC0 register description. ****************************************************************************
  [15:0] SRAM_SIZE — SRAM Size Indicates the size of the on-chip SRAM. Value Description 0x0007 2 KB of SRAM 0x000F 4 KB of SRAM 0x0017 6 KB of SRAM 0x001F 8 KB of SRAM 0x002F 12 KB of SRAM 0x003F 16 KB of SRAM 0x004F 20 KB of SRAM 0x005F 24 KB of SRAM 0x007F 32 KB of SRAM
