# F28x7x_ipc_regs_cpu1 register map
Vendor: Texas Instruments
Peripheral module from a debugger description file (folder C2000).
Address unit: 16 bits
Registers are 32-bit, read-write, no defined reset value unless marked. A register's access mark holds for its fields unless they carry their own. Offsets are as the file gives them; lines under a group give offsets from that group; [hi:lo] are bit positions; {n}, {i} and the like mark numbered series; 'fields as' and 'values as' point back to an identical list; <NAME> marks a mode.

## IPC_REGS_CPU1 — IPC CPU1 Registers
0x00 IPCACK — IPC incoming flag clear (acknowledge) register
  [31] IPC31 — Local IPC Flag 31 AcknowledgementLocal IPC Flag 31 Acknowledgement
  [31] IPC31 — Local IPC Flag 31 AcknowledgementLocal IPC Flag 31 Acknowledgement
  [30] IPC30 — Local IPC Flag 30 AcknowledgementLocal IPC Flag 30 Acknowledgement
  [30] IPC30 — Local IPC Flag 30 AcknowledgementLocal IPC Flag 30 Acknowledgement
  [29] IPC29 — Local IPC Flag 29 AcknowledgementLocal IPC Flag 29 Acknowledgement
  [29] IPC29 — Local IPC Flag 29 AcknowledgementLocal IPC Flag 29 Acknowledgement
  [28] IPC28 — Local IPC Flag 28 AcknowledgementLocal IPC Flag 28 Acknowledgement
  [28] IPC28 — Local IPC Flag 28 AcknowledgementLocal IPC Flag 28 Acknowledgement
  [27] IPC27 — Local IPC Flag 27 AcknowledgementLocal IPC Flag 27 Acknowledgement
  [27] IPC27 — Local IPC Flag 27 AcknowledgementLocal IPC Flag 27 Acknowledgement
  [26] IPC26 — Local IPC Flag 26 AcknowledgementLocal IPC Flag 26 Acknowledgement
  [26] IPC26 — Local IPC Flag 26 AcknowledgementLocal IPC Flag 26 Acknowledgement
  [25] IPC25 — Local IPC Flag 25 AcknowledgementLocal IPC Flag 25 Acknowledgement
  [25] IPC25 — Local IPC Flag 25 AcknowledgementLocal IPC Flag 25 Acknowledgement
  [24] IPC24 — Local IPC Flag 24 AcknowledgementLocal IPC Flag 24 Acknowledgement
  [24] IPC24 — Local IPC Flag 24 AcknowledgementLocal IPC Flag 24 Acknowledgement
  [23] IPC23 — Local IPC Flag 23 AcknowledgementLocal IPC Flag 23 Acknowledgement
  [23] IPC23 — Local IPC Flag 23 AcknowledgementLocal IPC Flag 23 Acknowledgement
  [22] IPC22 — Local IPC Flag 22 AcknowledgementLocal IPC Flag 22 Acknowledgement
  [22] IPC22 — Local IPC Flag 22 AcknowledgementLocal IPC Flag 22 Acknowledgement
  [21] IPC21 — Local IPC Flag 21 AcknowledgementLocal IPC Flag 21 Acknowledgement
  [21] IPC21 — Local IPC Flag 21 AcknowledgementLocal IPC Flag 21 Acknowledgement
  [20] IPC20 — Local IPC Flag 20 AcknowledgementLocal IPC Flag 20 Acknowledgement
  [20] IPC20 — Local IPC Flag 20 AcknowledgementLocal IPC Flag 20 Acknowledgement
  [19] IPC19 — Local IPC Flag 19 AcknowledgementLocal IPC Flag 19 Acknowledgement
  [19] IPC19 — Local IPC Flag 19 AcknowledgementLocal IPC Flag 19 Acknowledgement
  [18] IPC18 — Local IPC Flag 18 AcknowledgementLocal IPC Flag 18 Acknowledgement
  [18] IPC18 — Local IPC Flag 18 AcknowledgementLocal IPC Flag 18 Acknowledgement
  [17] IPC17 — Local IPC Flag 17 AcknowledgementLocal IPC Flag 17 Acknowledgement
  [17] IPC17 — Local IPC Flag 17 AcknowledgementLocal IPC Flag 17 Acknowledgement
  [16] IPC16 — Local IPC Flag 16 AcknowledgementLocal IPC Flag 16 Acknowledgement
  [16] IPC16 — Local IPC Flag 16 AcknowledgementLocal IPC Flag 16 Acknowledgement
  [15] IPC15 — Local IPC Flag 15 AcknowledgementLocal IPC Flag 15 Acknowledgement
  [15] IPC15 — Local IPC Flag 15 AcknowledgementLocal IPC Flag 15 Acknowledgement
  [14] IPC14 — Local IPC Flag 14 AcknowledgementLocal IPC Flag 14 Acknowledgement
  [14] IPC14 — Local IPC Flag 14 AcknowledgementLocal IPC Flag 14 Acknowledgement
  [13] IPC13 — Local IPC Flag 13 AcknowledgementLocal IPC Flag 13 Acknowledgement
  [13] IPC13 — Local IPC Flag 13 AcknowledgementLocal IPC Flag 13 Acknowledgement
  [12] IPC12 — Local IPC Flag 12 AcknowledgementLocal IPC Flag 12 Acknowledgement
  [12] IPC12 — Local IPC Flag 12 AcknowledgementLocal IPC Flag 12 Acknowledgement
  [11] IPC11 — Local IPC Flag 11 AcknowledgementLocal IPC Flag 11 Acknowledgement
  [11] IPC11 — Local IPC Flag 11 AcknowledgementLocal IPC Flag 11 Acknowledgement
  [10] IPC10 — Local IPC Flag 10 AcknowledgementLocal IPC Flag 10 Acknowledgement
  [10] IPC10 — Local IPC Flag 10 AcknowledgementLocal IPC Flag 10 Acknowledgement
  [9] IPC9 — Local IPC Flag 9 AcknowledgementLocal IPC Flag 9 Acknowledgement
  [9] IPC9 — Local IPC Flag 9 AcknowledgementLocal IPC Flag 9 Acknowledgement
  [8] IPC8 — Local IPC Flag 8 AcknowledgementLocal IPC Flag 8 Acknowledgement
  [8] IPC8 — Local IPC Flag 8 AcknowledgementLocal IPC Flag 8 Acknowledgement
  [7] IPC7 — Local IPC Flag 7 AcknowledgementLocal IPC Flag 7 Acknowledgement
  [7] IPC7 — Local IPC Flag 7 AcknowledgementLocal IPC Flag 7 Acknowledgement
  [6] IPC6 — Local IPC Flag 6 AcknowledgementLocal IPC Flag 6 Acknowledgement
  [6] IPC6 — Local IPC Flag 6 AcknowledgementLocal IPC Flag 6 Acknowledgement
  [5] IPC5 — Local IPC Flag 5 AcknowledgementLocal IPC Flag 5 Acknowledgement
  [5] IPC5 — Local IPC Flag 5 AcknowledgementLocal IPC Flag 5 Acknowledgement
  [4] IPC4 — Local IPC Flag 4 AcknowledgementLocal IPC Flag 4 Acknowledgement
  [4] IPC4 — Local IPC Flag 4 AcknowledgementLocal IPC Flag 4 Acknowledgement
  [3] IPC3 — Local IPC Flag 3 AcknowledgementLocal IPC Flag 3 Acknowledgement
  [3] IPC3 — Local IPC Flag 3 AcknowledgementLocal IPC Flag 3 Acknowledgement
  [2] IPC2 — Local IPC Flag 2 AcknowledgementLocal IPC Flag 2 Acknowledgement
  [2] IPC2 — Local IPC Flag 2 AcknowledgementLocal IPC Flag 2 Acknowledgement
  [1] IPC1 — Local IPC Flag 1 AcknowledgementLocal IPC Flag 1 Acknowledgement
  [1] IPC1 — Local IPC Flag 1 AcknowledgementLocal IPC Flag 1 Acknowledgement
  [0] IPC0 — Local IPC Flag 0 AcknowledgementLocal IPC Flag 0 Acknowledgement
  [0] IPC0 — Local IPC Flag 0 AcknowledgementLocal IPC Flag 0 Acknowledgement
0x02 IPCSTS — IPC incoming flag status register
  [31] IPC31 — Local IPC Flag 31 StatusLocal IPC Flag 31 Status
  [31] IPC31 — Local IPC Flag 31 StatusLocal IPC Flag 31 Status
  [30] IPC30 — Local IPC Flag 30 StatusLocal IPC Flag 30 Status
  [30] IPC30 — Local IPC Flag 30 StatusLocal IPC Flag 30 Status
  [29] IPC29 — Local IPC Flag 29 StatusLocal IPC Flag 29 Status
  [29] IPC29 — Local IPC Flag 29 StatusLocal IPC Flag 29 Status
  [28] IPC28 — Local IPC Flag 28 StatusLocal IPC Flag 28 Status
  [28] IPC28 — Local IPC Flag 28 StatusLocal IPC Flag 28 Status
  [27] IPC27 — Local IPC Flag 27 StatusLocal IPC Flag 27 Status
  [27] IPC27 — Local IPC Flag 27 StatusLocal IPC Flag 27 Status
  [26] IPC26 — Local IPC Flag 26 StatusLocal IPC Flag 26 Status
  [26] IPC26 — Local IPC Flag 26 StatusLocal IPC Flag 26 Status
  [25] IPC25 — Local IPC Flag 25 StatusLocal IPC Flag 25 Status
  [25] IPC25 — Local IPC Flag 25 StatusLocal IPC Flag 25 Status
  [24] IPC24 — Local IPC Flag 24 StatusLocal IPC Flag 24 Status
  [24] IPC24 — Local IPC Flag 24 StatusLocal IPC Flag 24 Status
  [23] IPC23 — Local IPC Flag 23 StatusLocal IPC Flag 23 Status
  [23] IPC23 — Local IPC Flag 23 StatusLocal IPC Flag 23 Status
  [22] IPC22 — Local IPC Flag 22 StatusLocal IPC Flag 22 Status
  [22] IPC22 — Local IPC Flag 22 StatusLocal IPC Flag 22 Status
  [21] IPC21 — Local IPC Flag 21 StatusLocal IPC Flag 21 Status
  [21] IPC21 — Local IPC Flag 21 StatusLocal IPC Flag 21 Status
  [20] IPC20 — Local IPC Flag 20 StatusLocal IPC Flag 20 Status
  [20] IPC20 — Local IPC Flag 20 StatusLocal IPC Flag 20 Status
  [19] IPC19 — Local IPC Flag 19 StatusLocal IPC Flag 19 Status
  [19] IPC19 — Local IPC Flag 19 StatusLocal IPC Flag 19 Status
  [18] IPC18 — Local IPC Flag 18 StatusLocal IPC Flag 18 Status
  [18] IPC18 — Local IPC Flag 18 StatusLocal IPC Flag 18 Status
  [17] IPC17 — Local IPC Flag 17 StatusLocal IPC Flag 17 Status
  [17] IPC17 — Local IPC Flag 17 StatusLocal IPC Flag 17 Status
  [16] IPC16 — Local IPC Flag 16 StatusLocal IPC Flag 16 Status
  [16] IPC16 — Local IPC Flag 16 StatusLocal IPC Flag 16 Status
  [15] IPC15 — Local IPC Flag 15 StatusLocal IPC Flag 15 Status
  [15] IPC15 — Local IPC Flag 15 StatusLocal IPC Flag 15 Status
  [14] IPC14 — Local IPC Flag 14 StatusLocal IPC Flag 14 Status
  [14] IPC14 — Local IPC Flag 14 StatusLocal IPC Flag 14 Status
  [13] IPC13 — Local IPC Flag 13 StatusLocal IPC Flag 13 Status
  [13] IPC13 — Local IPC Flag 13 StatusLocal IPC Flag 13 Status
  [12] IPC12 — Local IPC Flag 12 StatusLocal IPC Flag 12 Status
  [12] IPC12 — Local IPC Flag 12 StatusLocal IPC Flag 12 Status
  [11] IPC11 — Local IPC Flag 11 StatusLocal IPC Flag 11 Status
  [11] IPC11 — Local IPC Flag 11 StatusLocal IPC Flag 11 Status
  [10] IPC10 — Local IPC Flag 10 StatusLocal IPC Flag 10 Status
  [10] IPC10 — Local IPC Flag 10 StatusLocal IPC Flag 10 Status
  [9] IPC9 — Local IPC Flag 9 StatusLocal IPC Flag 9 Status
  [9] IPC9 — Local IPC Flag 9 StatusLocal IPC Flag 9 Status
  [8] IPC8 — Local IPC Flag 8 StatusLocal IPC Flag 8 Status
  [8] IPC8 — Local IPC Flag 8 StatusLocal IPC Flag 8 Status
  [7] IPC7 — Local IPC Flag 7 StatusLocal IPC Flag 7 Status
  [7] IPC7 — Local IPC Flag 7 StatusLocal IPC Flag 7 Status
  [6] IPC6 — Local IPC Flag 6 StatusLocal IPC Flag 6 Status
  [6] IPC6 — Local IPC Flag 6 StatusLocal IPC Flag 6 Status
  [5] IPC5 — Local IPC Flag 5 StatusLocal IPC Flag 5 Status
  [5] IPC5 — Local IPC Flag 5 StatusLocal IPC Flag 5 Status
  [4] IPC4 — Local IPC Flag 4 StatusLocal IPC Flag 4 Status
  [4] IPC4 — Local IPC Flag 4 StatusLocal IPC Flag 4 Status
  [3] IPC3 — Local IPC Flag 3 StatusLocal IPC Flag 3 Status
  [3] IPC3 — Local IPC Flag 3 StatusLocal IPC Flag 3 Status
  [2] IPC2 — Local IPC Flag 2 StatusLocal IPC Flag 2 Status
  [2] IPC2 — Local IPC Flag 2 StatusLocal IPC Flag 2 Status
  [1] IPC1 — Local IPC Flag 1 StatusLocal IPC Flag 1 Status
  [1] IPC1 — Local IPC Flag 1 StatusLocal IPC Flag 1 Status
  [0] IPC0 — Local IPC Flag 0 StatusLocal IPC Flag 0 Status
  [0] IPC0 — Local IPC Flag 0 StatusLocal IPC Flag 0 Status
0x04 IPCSET — IPC remote flag set register
  [31] IPC31 — Set Remote IPC31 FlagSet Remote IPC31 Flag
  [31] IPC31 — Set Remote IPC31 FlagSet Remote IPC31 Flag
  [30] IPC30 — Set Remote IPC30 FlagSet Remote IPC30 Flag
  [30] IPC30 — Set Remote IPC30 FlagSet Remote IPC30 Flag
  [29] IPC29 — Set Remote IPC29 FlagSet Remote IPC29 Flag
  [29] IPC29 — Set Remote IPC29 FlagSet Remote IPC29 Flag
  [28] IPC28 — Set Remote IPC28 FlagSet Remote IPC28 Flag
  [28] IPC28 — Set Remote IPC28 FlagSet Remote IPC28 Flag
  [27] IPC27 — Set Remote IPC27 FlagSet Remote IPC27 Flag
  [27] IPC27 — Set Remote IPC27 FlagSet Remote IPC27 Flag
  [26] IPC26 — Set Remote IPC26 FlagSet Remote IPC26 Flag
  [26] IPC26 — Set Remote IPC26 FlagSet Remote IPC26 Flag
  [25] IPC25 — Set Remote IPC25 FlagSet Remote IPC25 Flag
  [25] IPC25 — Set Remote IPC25 FlagSet Remote IPC25 Flag
  [24] IPC24 — Set Remote IPC24 FlagSet Remote IPC24 Flag
  [24] IPC24 — Set Remote IPC24 FlagSet Remote IPC24 Flag
  [23] IPC23 — Set Remote IPC23 FlagSet Remote IPC23 Flag
  [23] IPC23 — Set Remote IPC23 FlagSet Remote IPC23 Flag
  [22] IPC22 — Set Remote IPC22 FlagSet Remote IPC22 Flag
  [22] IPC22 — Set Remote IPC22 FlagSet Remote IPC22 Flag
  [21] IPC21 — Set Remote IPC21 FlagSet Remote IPC21 Flag
  [21] IPC21 — Set Remote IPC21 FlagSet Remote IPC21 Flag
  [20] IPC20 — Set Remote IPC20 FlagSet Remote IPC20 Flag
  [20] IPC20 — Set Remote IPC20 FlagSet Remote IPC20 Flag
  [19] IPC19 — Set Remote IPC19 FlagSet Remote IPC19 Flag
  [19] IPC19 — Set Remote IPC19 FlagSet Remote IPC19 Flag
  [18] IPC18 — Set Remote IPC18 FlagSet Remote IPC18 Flag
  [18] IPC18 — Set Remote IPC18 FlagSet Remote IPC18 Flag
  [17] IPC17 — Set Remote IPC17 FlagSet Remote IPC17 Flag
  [17] IPC17 — Set Remote IPC17 FlagSet Remote IPC17 Flag
  [16] IPC16 — Set Remote IPC16 FlagSet Remote IPC16 Flag
  [16] IPC16 — Set Remote IPC16 FlagSet Remote IPC16 Flag
  [15] IPC15 — Set Remote IPC15 FlagSet Remote IPC15 Flag
  [15] IPC15 — Set Remote IPC15 FlagSet Remote IPC15 Flag
  [14] IPC14 — Set Remote IPC14 FlagSet Remote IPC14 Flag
  [14] IPC14 — Set Remote IPC14 FlagSet Remote IPC14 Flag
  [13] IPC13 — Set Remote IPC13 FlagSet Remote IPC13 Flag
  [13] IPC13 — Set Remote IPC13 FlagSet Remote IPC13 Flag
  [12] IPC12 — Set Remote IPC12 FlagSet Remote IPC12 Flag
  [12] IPC12 — Set Remote IPC12 FlagSet Remote IPC12 Flag
  [11] IPC11 — Set Remote IPC11 FlagSet Remote IPC11 Flag
  [11] IPC11 — Set Remote IPC11 FlagSet Remote IPC11 Flag
  [10] IPC10 — Set Remote IPC10 FlagSet Remote IPC10 Flag
  [10] IPC10 — Set Remote IPC10 FlagSet Remote IPC10 Flag
  [9] IPC9 — Set Remote IPC9 FlagSet Remote IPC9 Flag
  [9] IPC9 — Set Remote IPC9 FlagSet Remote IPC9 Flag
  [8] IPC8 — Set Remote IPC8 FlagSet Remote IPC8 Flag
  [8] IPC8 — Set Remote IPC8 FlagSet Remote IPC8 Flag
  [7] IPC7 — Set Remote IPC7 FlagSet Remote IPC7 Flag
  [7] IPC7 — Set Remote IPC7 FlagSet Remote IPC7 Flag
  [6] IPC6 — Set Remote IPC6 FlagSet Remote IPC6 Flag
  [6] IPC6 — Set Remote IPC6 FlagSet Remote IPC6 Flag
  [5] IPC5 — Set Remote IPC5 FlagSet Remote IPC5 Flag
  [5] IPC5 — Set Remote IPC5 FlagSet Remote IPC5 Flag
  [4] IPC4 — Set Remote IPC4 FlagSet Remote IPC4 Flag
  [4] IPC4 — Set Remote IPC4 FlagSet Remote IPC4 Flag
  [3] IPC3 — Set Remote IPC3 FlagSet Remote IPC3 Flag
  [3] IPC3 — Set Remote IPC3 FlagSet Remote IPC3 Flag
  [2] IPC2 — Set Remote IPC2 FlagSet Remote IPC2 Flag
  [2] IPC2 — Set Remote IPC2 FlagSet Remote IPC2 Flag
  [1] IPC1 — Set Remote IPC1 FlagSet Remote IPC1 Flag
  [1] IPC1 — Set Remote IPC1 FlagSet Remote IPC1 Flag
  [0] IPC0 — Set Remote IPC0 FlagSet Remote IPC0 Flag
  [0] IPC0 — Set Remote IPC0 FlagSet Remote IPC0 Flag
0x06 IPCCLR — IPC remote flag clear register
  [31] IPC31 — Clear Remote IPC31 FlagClear Remote IPC31 Flag
  [31] IPC31 — Clear Remote IPC31 FlagClear Remote IPC31 Flag
  [30] IPC30 — Clear Remote IPC30 FlagClear Remote IPC30 Flag
  [30] IPC30 — Clear Remote IPC30 FlagClear Remote IPC30 Flag
  [29] IPC29 — Clear Remote IPC29 FlagClear Remote IPC29 Flag
  [29] IPC29 — Clear Remote IPC29 FlagClear Remote IPC29 Flag
  [28] IPC28 — Clear Remote IPC28 FlagClear Remote IPC28 Flag
  [28] IPC28 — Clear Remote IPC28 FlagClear Remote IPC28 Flag
  [27] IPC27 — Clear Remote IPC27 FlagClear Remote IPC27 Flag
  [27] IPC27 — Clear Remote IPC27 FlagClear Remote IPC27 Flag
  [26] IPC26 — Clear Remote IPC26 FlagClear Remote IPC26 Flag
  [26] IPC26 — Clear Remote IPC26 FlagClear Remote IPC26 Flag
  [25] IPC25 — Clear Remote IPC25 FlagClear Remote IPC25 Flag
  [25] IPC25 — Clear Remote IPC25 FlagClear Remote IPC25 Flag
  [24] IPC24 — Clear Remote IPC24 FlagClear Remote IPC24 Flag
  [24] IPC24 — Clear Remote IPC24 FlagClear Remote IPC24 Flag
  [23] IPC23 — Clear Remote IPC23 FlagClear Remote IPC23 Flag
  [23] IPC23 — Clear Remote IPC23 FlagClear Remote IPC23 Flag
  [22] IPC22 — Clear Remote IPC22 FlagClear Remote IPC22 Flag
  [22] IPC22 — Clear Remote IPC22 FlagClear Remote IPC22 Flag
  [21] IPC21 — Clear Remote IPC21 FlagClear Remote IPC21 Flag
  [21] IPC21 — Clear Remote IPC21 FlagClear Remote IPC21 Flag
  [20] IPC20 — Clear Remote IPC20 FlagClear Remote IPC20 Flag
  [20] IPC20 — Clear Remote IPC20 FlagClear Remote IPC20 Flag
  [19] IPC19 — Clear Remote IPC19 FlagClear Remote IPC19 Flag
  [19] IPC19 — Clear Remote IPC19 FlagClear Remote IPC19 Flag
  [18] IPC18 — Clear Remote IPC18 FlagClear Remote IPC18 Flag
  [18] IPC18 — Clear Remote IPC18 FlagClear Remote IPC18 Flag
  [17] IPC17 — Clear Remote IPC17 FlagClear Remote IPC17 Flag
  [17] IPC17 — Clear Remote IPC17 FlagClear Remote IPC17 Flag
  [16] IPC16 — Clear Remote IPC16 FlagClear Remote IPC16 Flag
  [16] IPC16 — Clear Remote IPC16 FlagClear Remote IPC16 Flag
  [15] IPC15 — Clear Remote IPC15 FlagClear Remote IPC15 Flag
  [15] IPC15 — Clear Remote IPC15 FlagClear Remote IPC15 Flag
  [14] IPC14 — Clear Remote IPC14 FlagClear Remote IPC14 Flag
  [14] IPC14 — Clear Remote IPC14 FlagClear Remote IPC14 Flag
  [13] IPC13 — Clear Remote IPC13 FlagClear Remote IPC13 Flag
  [13] IPC13 — Clear Remote IPC13 FlagClear Remote IPC13 Flag
  [12] IPC12 — Clear Remote IPC12 FlagClear Remote IPC12 Flag
  [12] IPC12 — Clear Remote IPC12 FlagClear Remote IPC12 Flag
  [11] IPC11 — Clear Remote IPC11 FlagClear Remote IPC11 Flag
  [11] IPC11 — Clear Remote IPC11 FlagClear Remote IPC11 Flag
  [10] IPC10 — Clear Remote IPC10 FlagClear Remote IPC10 Flag
  [10] IPC10 — Clear Remote IPC10 FlagClear Remote IPC10 Flag
  [9] IPC9 — Clear Remote IPC9 FlagClear Remote IPC9 Flag
  [9] IPC9 — Clear Remote IPC9 FlagClear Remote IPC9 Flag
  [8] IPC8 — Clear Remote IPC8 FlagClear Remote IPC8 Flag
  [8] IPC8 — Clear Remote IPC8 FlagClear Remote IPC8 Flag
  [7] IPC7 — Clear Remote IPC7 FlagClear Remote IPC7 Flag
  [7] IPC7 — Clear Remote IPC7 FlagClear Remote IPC7 Flag
  [6] IPC6 — Clear Remote IPC6 FlagClear Remote IPC6 Flag
  [6] IPC6 — Clear Remote IPC6 FlagClear Remote IPC6 Flag
  [5] IPC5 — Clear Remote IPC5 FlagClear Remote IPC5 Flag
  [5] IPC5 — Clear Remote IPC5 FlagClear Remote IPC5 Flag
  [4] IPC4 — Clear Remote IPC4 FlagClear Remote IPC4 Flag
  [4] IPC4 — Clear Remote IPC4 FlagClear Remote IPC4 Flag
  [3] IPC3 — Clear Remote IPC3 FlagClear Remote IPC3 Flag
  [3] IPC3 — Clear Remote IPC3 FlagClear Remote IPC3 Flag
  [2] IPC2 — Clear Remote IPC2 FlagClear Remote IPC2 Flag
  [2] IPC2 — Clear Remote IPC2 FlagClear Remote IPC2 Flag
  [1] IPC1 — Clear Remote IPC1 FlagClear Remote IPC1 Flag
  [1] IPC1 — Clear Remote IPC1 FlagClear Remote IPC1 Flag
  [0] IPC0 — Clear Remote IPC0 FlagClear Remote IPC0 Flag
  [0] IPC0 — Clear Remote IPC0 FlagClear Remote IPC0 Flag
0x08 IPCFLG — IPC remote flag status register
  [31] IPC31 — Remote IPC31 Flag StatusRemote IPC31 Flag Status
  [31] IPC31 — Remote IPC31 Flag StatusRemote IPC31 Flag Status
  [30] IPC30 — Remote IPC30 Flag StatusRemote IPC30 Flag Status
  [30] IPC30 — Remote IPC30 Flag StatusRemote IPC30 Flag Status
  [29] IPC29 — Remote IPC29 Flag StatusRemote IPC29 Flag Status
  [29] IPC29 — Remote IPC29 Flag StatusRemote IPC29 Flag Status
  [28] IPC28 — Remote IPC28 Flag StatusRemote IPC28 Flag Status
  [28] IPC28 — Remote IPC28 Flag StatusRemote IPC28 Flag Status
  [27] IPC27 — Remote IPC27 Flag StatusRemote IPC27 Flag Status
  [27] IPC27 — Remote IPC27 Flag StatusRemote IPC27 Flag Status
  [26] IPC26 — Remote IPC26 Flag StatusRemote IPC26 Flag Status
  [26] IPC26 — Remote IPC26 Flag StatusRemote IPC26 Flag Status
  [25] IPC25 — Remote IPC25 Flag StatusRemote IPC25 Flag Status
  [25] IPC25 — Remote IPC25 Flag StatusRemote IPC25 Flag Status
  [24] IPC24 — Remote IPC24 Flag StatusRemote IPC24 Flag Status
  [24] IPC24 — Remote IPC24 Flag StatusRemote IPC24 Flag Status
  [23] IPC23 — Remote IPC23 Flag StatusRemote IPC23 Flag Status
  [23] IPC23 — Remote IPC23 Flag StatusRemote IPC23 Flag Status
  [22] IPC22 — Remote IPC22 Flag StatusRemote IPC22 Flag Status
  [22] IPC22 — Remote IPC22 Flag StatusRemote IPC22 Flag Status
  [21] IPC21 — Remote IPC21 Flag StatusRemote IPC21 Flag Status
  [21] IPC21 — Remote IPC21 Flag StatusRemote IPC21 Flag Status
  [20] IPC20 — Remote IPC20 Flag StatusRemote IPC20 Flag Status
  [20] IPC20 — Remote IPC20 Flag StatusRemote IPC20 Flag Status
  [19] IPC19 — Remote IPC19 Flag StatusRemote IPC19 Flag Status
  [19] IPC19 — Remote IPC19 Flag StatusRemote IPC19 Flag Status
  [18] IPC18 — Remote IPC18 Flag StatusRemote IPC18 Flag Status
  [18] IPC18 — Remote IPC18 Flag StatusRemote IPC18 Flag Status
  [17] IPC17 — Remote IPC17 Flag StatusRemote IPC17 Flag Status
  [17] IPC17 — Remote IPC17 Flag StatusRemote IPC17 Flag Status
  [16] IPC16 — Remote IPC16 Flag StatusRemote IPC16 Flag Status
  [16] IPC16 — Remote IPC16 Flag StatusRemote IPC16 Flag Status
  [15] IPC15 — Remote IPC15 Flag StatusRemote IPC15 Flag Status
  [15] IPC15 — Remote IPC15 Flag StatusRemote IPC15 Flag Status
  [14] IPC14 — Remote IPC14 Flag StatusRemote IPC14 Flag Status
  [14] IPC14 — Remote IPC14 Flag StatusRemote IPC14 Flag Status
  [13] IPC13 — Remote IPC13 Flag StatusRemote IPC13 Flag Status
  [13] IPC13 — Remote IPC13 Flag StatusRemote IPC13 Flag Status
  [12] IPC12 — Remote IPC12 Flag StatusRemote IPC12 Flag Status
  [12] IPC12 — Remote IPC12 Flag StatusRemote IPC12 Flag Status
  [11] IPC11 — Remote IPC11 Flag StatusRemote IPC11 Flag Status
  [11] IPC11 — Remote IPC11 Flag StatusRemote IPC11 Flag Status
  [10] IPC10 — Remote IPC10 Flag StatusRemote IPC10 Flag Status
  [10] IPC10 — Remote IPC10 Flag StatusRemote IPC10 Flag Status
  [9] IPC9 — Remote IPC9 Flag StatusRemote IPC9 Flag Status
  [9] IPC9 — Remote IPC9 Flag StatusRemote IPC9 Flag Status
  [8] IPC8 — Remote IPC8 Flag StatusRemote IPC8 Flag Status
  [8] IPC8 — Remote IPC8 Flag StatusRemote IPC8 Flag Status
  [7] IPC7 — Remote IPC7 Flag StatusRemote IPC7 Flag Status
  [7] IPC7 — Remote IPC7 Flag StatusRemote IPC7 Flag Status
  [6] IPC6 — Remote IPC6 Flag StatusRemote IPC6 Flag Status
  [6] IPC6 — Remote IPC6 Flag StatusRemote IPC6 Flag Status
  [5] IPC5 — Remote IPC5 Flag StatusRemote IPC5 Flag Status
  [5] IPC5 — Remote IPC5 Flag StatusRemote IPC5 Flag Status
  [4] IPC4 — Remote IPC4 Flag StatusRemote IPC4 Flag Status
  [4] IPC4 — Remote IPC4 Flag StatusRemote IPC4 Flag Status
  [3] IPC3 — Remote IPC3 Flag StatusRemote IPC3 Flag Status
  [3] IPC3 — Remote IPC3 Flag StatusRemote IPC3 Flag Status
  [2] IPC2 — Remote IPC2 Flag StatusRemote IPC2 Flag Status
  [2] IPC2 — Remote IPC2 Flag StatusRemote IPC2 Flag Status
  [1] IPC1 — Remote IPC1 Flag StatusRemote IPC1 Flag Status
  [1] IPC1 — Remote IPC1 Flag StatusRemote IPC1 Flag Status
  [0] IPC0 — Remote IPC0 Flag StatusRemote IPC0 Flag Status
  [0] IPC0 — Remote IPC0 Flag StatusRemote IPC0 Flag Status
0x0C IPCCOUNTERL — IPC Counter Low Register
  [31:0] COUNT — IPC Counter's lower 32-bitIPC Counter's lower 32-bit
  [31:0] COUNT — IPC Counter's lower 32-bitIPC Counter's lower 32-bit
0x0E IPCCOUNTERH — IPC Counter High Register
  [31:0] COUNT — IPC Counter's upper 32-bitIPC Counter's upper 32-bit
  [31:0] COUNT — IPC Counter's upper 32-bitIPC Counter's upper 32-bit
0x10 IPCSENDCOM — Local to Remote IPC Command Register
  [31:0] COMMAND — Local to Remote IPC CommandLocal to Remote IPC Command
  [31:0] COMMAND — Local to Remote IPC CommandLocal to Remote IPC Command
0x12 IPCSENDADDR — Local to Remote IPC Address Register
  [31:0] ADDRESS — Local to Remote IPC AddressLocal to Remote IPC Address
  [31:0] ADDRESS — Local to Remote IPC AddressLocal to Remote IPC Address
0x14 IPCSENDDATA — Local to Remote IPC Data Register
  [31:0] WDATA — Local to Remote IPC DataLocal to Remote IPC Data
  [31:0] WDATA — Local to Remote IPC DataLocal to Remote IPC Data
0x16 IPCREMOTEREPLY — Remote to Local IPC Reply Data Register
  [31:0] RDATA — Remote to Local IPC Return DataRemote to Local IPC Return Data
  [31:0] RDATA — Remote to Local IPC Return DataRemote to Local IPC Return Data
0x18 IPCRECVCOM — Remote to Local IPC Command Register
  [31:0] COMMAND — Remote to Local IPC CommandRemote to Local IPC Command
  [31:0] COMMAND — Remote to Local IPC CommandRemote to Local IPC Command
0x1A IPCRECVADDR — Remote to Local IPC Address Register
  [31:0] ADDRESS — Remote to Local IPC AddressRemote to Local IPC Address
  [31:0] ADDRESS — Remote to Local IPC AddressRemote to Local IPC Address
0x1C IPCRECVDATA — Remote to Local IPC Data Register
  [31:0] WDATA — Remote to Local IPC DataRemote to Local IPC Data
  [31:0] WDATA — Remote to Local IPC DataRemote to Local IPC Data
0x1E IPCLOCALREPLY — Local to Remote IPC Reply Data Register
  [31:0] RDATA — Local to Remote IPC Return DataLocal to Remote IPC Return Data
  [31:0] RDATA — Local to Remote IPC Return DataLocal to Remote IPC Return Data
0x20 IPCBOOTSTS — CPU2 to CPU1 IPC Boot Status Register
  [31:0] BOOTSTS — CPU2 to CPU1 IPC Boot StatusCPU2 to CPU1 IPC Boot Status
  [31:0] BOOTSTS — CPU2 to CPU1 IPC Boot StatusCPU2 to CPU1 IPC Boot Status
0x22 IPCBOOTMODE — CPU1 to CPU2 IPC Boot Mode Register
  [31:0] BOOTMODE — CPU1 to CPU2 IPC Boot ModeCPU1 to CPU2 IPC Boot Mode
  [31:0] BOOTMODE — CPU1 to CPU2 IPC Boot ModeCPU1 to CPU2 IPC Boot Mode
0x24 PUMPREQUEST — Flash programming semaphore PUMP request register
  [31:16] KEY — Key Qualifier for writes to this registerKey Qualifier for writes to this register
  [31:16] KEY — Key Qualifier for writes to this registerKey Qualifier for writes to this register
  [1:0] SEM — Flash Pump Request Semaphore between CPU1 and CPU2Flash Pump Request Semaphore between CPU1 and CPU2
  [1:0] SEM — Flash Pump Request Semaphore between CPU1 and CPU2Flash Pump Request Semaphore between CPU1 and CPU2
